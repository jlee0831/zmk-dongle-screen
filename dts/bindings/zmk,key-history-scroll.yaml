## dts/bindings/zmk,key-history-scroll.yaml
```yaml
description: Key history scroll behavior

compatible: "zmk,key-history-scroll"

include:
  - name: zero_param.yaml

properties:
  direction:
    type: int
    required: true
    description: "0 = scroll up toward older entries, 1 = scroll down toward newer entries"
```

## dts/bindings/zmk,key-history-toggle.yaml
```yaml
description: Key history toggle behavior

compatible: "zmk,key-history-toggle"

include:
  - name: zero_param.yaml
```
